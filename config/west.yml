## config/west.yml
```yaml
manifest:
  remotes:
    - name: zmkfirmware
      url-base: https://github.com/zmkfirmware
    - name: Cyboard-DigitalTailor
      url-base: https://github.com/Cyboard-DigitalTailor
    # Additional modules containing boards/shields/custom code can be listed here as well
    # See https://docs.zephyrproject.org/3.2.0/develop/west/manifest.html#projects
  projects:
    - name: zmk
      remote: zmkfirmware
      revision: v0.3.0 # not main, because the zmk-keyboard remote is based on v0.3.0 to avoid frequent breakges
      import: app/west.yml
    - name: zmk-keyboards
      remote: Cyboard-DigitalTailor
      revision: main
      import: config/west.yml
  self:
    path: config
```
